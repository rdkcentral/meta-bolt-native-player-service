## conf/layer.conf
```bitbake
BBPATH .= ":${LAYERDIR}"

BBFILES += "${LAYERDIR}/recipes-*/*/*.bb \
            ${LAYERDIR}/recipes-*/*/*.bbappend"

BBFILE_COLLECTIONS += "meta-bolt-nativeplayer"
BBFILE_PATTERN_meta-bolt-nativeplayer = "^${LAYERDIR}/"
BBFILE_PRIORITY_meta-bolt-nativeplayer = "10"

LAYERDEPENDS_meta-bolt-nativeplayer = "bolt-base"
LAYERSERIES_COMPAT_meta-bolt-nativeplayer = "kirkstone"
```
